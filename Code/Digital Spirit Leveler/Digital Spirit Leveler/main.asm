;
; DIGITAL_LEVEL_LCD.asm
;
; Created: 12/28/2023 1:43:29 PM
; Author : SAHAN SIRIWARDENA
;


.INCLUDE "M328PDEF.INC"
.CSEG
.ORG 0X00
.def RES1 = R2
.def RES2 = R3
.def RES3 = R4
.def RES4 = R5
.EQU A0_LOW = 0X0145
.EQU A0_HIGH = 0X0146
.EQU C0_LOW = 0X0147
.EQU C0_HIGH = 0X0148
.EQU B0_LOW = 0X0149
.EQU B0_HIGH = 0X014A
.EQU A0_SQURE_LOW=0X014B
.EQU A0_SQURE_MID=0X014C
.EQU A0_SQURE_HIGH=0X014D
.EQU C0_SQURE_LOW=0X014E
.EQU C0_SQURE_MID=0X014F
.EQU C0_SQURE_HIGH=0X0150
.EQU B0_SQURE_LOW=0X0151
.EQU B0_SQURE_MID=0X0152
.EQU B0_SQURE_HIGH=0X0153
.EQU SQURE_LOW=0X0154
.EQU SQURE_MID=0X0155
.EQU SQURE_HIGH=0X0156


.EQU A0_SIGN=0X0157
.EQU C0_SIGN=0X0158
.EQU B0_SIGN=0X0159
.EQU X_FINAL=0X015A
.EQU Y_FINAL=0X015B
.EQU Z_FINAL=0X015C

.EQU DOWN_ROOT_01_L=0X015D
.EQU DOWN_ROOT_01_M=0X015E
.EQU DOWN_ROOT_01_H=0X015F
.EQU DOWN_ROOT_02_L=0X0160
.EQU DOWN_ROOT_02_M=0X0161
.EQU DOWN_ROOT_02_H=0X0162
.EQU DOWN_ROOT_03_L=0X0163
.EQU DOWN_ROOT_03_M=0X0164
.EQU DOWN_ROOT_03_H=0X0165
.EQU TEMP_L=0X0166
.EQU TEMP_M=0X0167
.EQU TEMP_H=0X0168

.EQU NUM1=0X64  ;100
.EQU SUB_NUM=0X1ED;493
.EQU PI=0X13A
.EQU UPPER_MULTI=0X3840
.EQU R0_SIGN=0X00

.EQU NINTY = 0B01011010
.EQU SEVENTY = 0B01000110
.EQU SIXTYNINE = 0B01000101
.EQU FOURTY = 0B00101000
.EQU THIRTYNINE = 0B00100111
.EQU FIVE = 0B00000101

;-------------------------------!!!!!TESTING PURPOSE ONLY!!!!!-----------------------------------
;.EQU CHECK1 =0X32 ;50
;.EQU CHECK2 =0X14 ;20
;------------------------------------------------------------------------------------------------

;------------------------------------------------------------------------------------------------
;DEFINE THE I/O PINS
START:
	LDI R16,0X40
	STS ADMUX,R16 ;SET VCC AS REFERENCE,RIGHT-JUSTIFIED DATA,ADC0
	LDI R16,0B10000111
	STS ADCSRA,R16 ;ENABLE ADC,ADC PRESCALER CLK/128
	
	LDI R16,0XFF
	OUT DDRD,R16 ;SET PORT D O/P DATA
	LDI R16,0XFF 
	OUT DDRB,R16 ;SET PORT B O/P COMMOND
	CBI PORTB,0  ;EN=0
	RCALL DELAY_MS ;WAIT FOR LCD POWER ON
	RCALL LCD_INIT ;INTIALIZING THE LCD

;--------------------------------------------------------------------------------------------------
;MAIN FUNCTION
MAIN:
	LDI R16,0X40
	STS ADMUX,R16 ;SET VCC AS REFERENCE,RIGHT-JUSTIFIED DATA,ADC0
READ_ADC_01:	
	LDI R17,0XC7
	STS ADCSRA,R17 ;SET ADSC IN ADCSRA TO START CONVERSION
LOOP_ADC1:		
	LDS R16,ADCSRA
	SBRS R16,4 ;SKIP JUMP WHEN CONVERTION IS DONE (FLAG SET)
	RJMP LOOP_ADC1
	LDI R17,0XD7
	STS ADCSRA,R17 ;TO SIGNAL 'READY-TO-BE-CLEARED' BY H/W
	LDS R30,ADCL ;GET THE LOW-BYTE RESULT FROM ADCL
	LDS R31,ADCH ;GET THE HIGH-BYTE RESULT FROM ADCH
	STS A0_LOW,R30
	STS A0_HIGH,R31
	LDI R17,0X00
	STS ADCSRA,R17 ;TO SIGNAL 'READY-TO-BE-CLEARED' BY H/W

	LDI R16,0X41
	STS ADMUX,R16 ;SET VCC AS REFERENCE,RIGHT-JUSTIFIED DATA,ADC0
READ_ADC_02:	
	LDI R17,0XC7
	STS ADCSRA,R17 ;SET ADSC IN ADCSRA TO START CONVERSION
LOOP_ADC2:		
	LDS R16,ADCSRA
	SBRS R16,4 ;SKIP JUMP WHEN CONVERTION IS DONE (FLAG SET)
	RJMP LOOP_ADC2
	LDI R17,0XD7
	STS ADCSRA,R17 ;TO SIGNAL 'READY-TO-BE-CLEARED' BY H/W
	LDS R30,ADCL ;GET THE LOW-BYTE RESULT FROM ADCL
	LDS R31,ADCH ;GET THE HIGH-BYTE RESULT FROM ADCH
	STS C0_LOW,R30
	STS C0_HIGH,R31
	LDI R17,0X00
	STS ADCSRA,R17 ;TO SIGNAL 'READY-TO-BE-CLEARED' BY H/W

	LDI R16,0X42
	STS ADMUX,R16 ;SET VCC AS REFERENCE,RIGHT-JUSTIFIED DATA,ADC0
READ_ADC_03:	
	LDI R17,0XC7
	STS ADCSRA,R17 ;SET ADSC IN ADCSRA TO START CONVERSION
LOOP_ADC3:		
	LDS R16,ADCSRA
	SBRS R16,4 ;SKIP JUMP WHEN CONVERTION IS DONE (FLAG SET)
	RJMP LOOP_ADC1
	LDI R17,0XD7
	STS ADCSRA,R17 ;TO SIGNAL 'READY-TO-BE-CLEARED' BY H/W
	LDS R30,ADCL ;GET THE LOW-BYTE RESULT FROM ADCL
	LDS R31,ADCH ;GET THE HIGH-BYTE RESULT FROM ADCH
	STS B0_LOW,R30
	STS B0_HIGH,R31
	LDI R17,0X00
	STS ADCSRA,R17 ;TO SIGNAL 'READY-TO-BE-CLEARED' BY H/W


	LDS R30,A0_LOW
	LDS R31,A0_HIGH
	RCALL MAP

	;----------------------------------------------------------------------------------------------

	STS A0_SIGN,R22
	STS A0_LOW,R16
	STS A0_HIGH,R17

	;-----------------------------------------------------------------------------------------------

	LDS R30,C0_LOW
	LDS R31,C0_HIGH
	RCALL MAP
	STS C0_SIGN,R22
	STS C0_LOW,R16
	STS C0_HIGH,R17

	;-----------------------------------------------------------------------------------------------

	LDS R30,B0_LOW
	LDS R31,B0_HIGH
	RCALL MAP
	STS B0_SIGN,R22
	STS B0_LOW,R16
	STS B0_HIGH,R17

;-------------------------------!!!!!TESTING PURPOSE ONLY!!!!!-------------------------------------
	;LDI R18,LOW(CHECK1)
	;STS A0_LOW,R18
	;LDI R18,HIGH(CHECK1)
	;STS A0_HIGH,R18
;--------------------------------------------------------------------------------------------------

	LDS R18,A0_LOW
	LDS R27,A0_HIGH
	RCALL POWER
	STS A0_SQURE_LOW,RES1;LOW BYTE
	STS A0_SQURE_MID,RES2;MID BYTE
	STS A0_SQURE_HIGH,RES3;HIGH BYTE
	RCALL CLEAR
	CLR RES1
	CLR RES2
	CLR RES3
	CLR RES4

;-------------------------------!!!!!TESTING PURPOSE ONLY!!!!!-------------------------------------

	;LDI R16,LOW(CHECK2)
	;STS C0_LOW,R16
	;LDI R16,HIGH(CHECK2)
	;STS C0_HIGH,R16

;--------------------------------------------------------------------------------------------------

	LDS R18,C0_LOW
	LDS R27,C0_HIGH
	RCALL POWER
	STS C0_SQURE_LOW,RES1;LOW BYTE
	STS C0_SQURE_MID,RES2;MID BYTE
	STS C0_SQURE_HIGH,RES3;HIGH BYTE
	RCALL CLEAR
	CLR RES1
	CLR RES2
	CLR RES3
	CLR RES4

;--------------------------------------------------------------------------------------------------

	LDS R18,B0_LOW
	LDS R27,B0_HIGH
	RCALL POWER
	STS B0_SQURE_LOW,RES1;LOW BYTE
	STS B0_SQURE_MID,RES2;MID BYTE
	STS B0_SQURE_HIGH,RES3;HIGH BYTE
	RCALL CLEAR
	CLR RES1
	CLR RES2
	CLR RES3
	CLR RES4

;--------------------------------------------------------------------------------------------------
;SQRT(A^2+C^2)
	LDS R16,A0_SQURE_LOW
	LDS R17,A0_SQURE_MID
	LDS R18,A0_SQURE_HIGH

	LDS R19,C0_SQURE_LOW
	LDS R20,C0_SQURE_MID
	LDS R21,C0_SQURE_HIGH

	ADC R16,R19
	ADC R17,R20
	ADC R18,R21

	MOV R24,R16
	MOV R25,R17
	MOV R26,R18
	RCALL SQURE_ROOT

	STS DOWN_ROOT_01_L,R20
	STS DOWN_ROOT_01_M,R21

;--------------------------------------------------------------------------------------------------
;SQRT(B^2+C^2)
	LDS R16,B0_SQURE_LOW
	LDS R17,B0_SQURE_MID
	LDS R18,B0_SQURE_HIGH

	LDS R19,C0_SQURE_LOW
	LDS R20,C0_SQURE_MID
	LDS R21,C0_SQURE_HIGH

	ADC R16,R19
	ADC R17,R20
	ADC R18,R21

	MOV R24,R16
	MOV R25,R17
	MOV R26,R18
	RCALL SQURE_ROOT

	STS DOWN_ROOT_02_L,R20
	STS DOWN_ROOT_02_M,R21

;--------------------------------------------------------------------------------------------------
;SQRT(A^2+B^2)
	LDS R16,A0_SQURE_LOW
	LDS R17,A0_SQURE_MID
	LDS R18,A0_SQURE_HIGH

	LDS R19,B0_SQURE_LOW
	LDS R20,B0_SQURE_MID
	LDS R21,B0_SQURE_HIGH

	ADC R16,R19
	ADC R17,R20
	ADC R18,R21

	MOV R24,R16
	MOV R25,R17
	MOV R26,R18
	RCALL SQURE_ROOT

	STS DOWN_ROOT_03_L,R20
	STS DOWN_ROOT_03_M,R21


	RCALL CLEAR
;------------------------------------------X-----------------------------------------

	;-----25XD1^2------
	LDI R16,0X19;
	LDI R17,0X00
	LDS R30,DOWN_ROOT_01_L
	LDS R31,DOWN_ROOT_01_M
	LDS R27,DOWN_ROOT_01_H
	STS TEMP_L,R30
	STS TEMP_M,R31
	STS TEMP_H,R27
	CLR R27
	RCALL MULTI
	STS DOWN_ROOT_01_L,RES1;LOW BYTE
	STS DOWN_ROOT_01_M,RES2;MID BYTE
	STS DOWN_ROOT_01_H,RES3;HIGH BYTE
	RCALL CLEAR
	CLR RES1
	CLR RES2
	CLR RES3
	CLR RES4
	;------------------
	;-----80XB0^2------
	LDI R16,0X50;
	LDI R17,0X00
	LDS R30,B0_SQURE_LOW
	LDS R31,B0_SQURE_MID
	RCALL MULTI
	MOV R17,RES1  ;R2 ;LOW BYTE
	MOV R18,RES2  ;R3 ;MID BYTE
	MOV R20,RES3  ;R4 ;HIGH BYTE
	STS B0_SQURE_LOW,RES1;LOW BYTE
	STS B0_SQURE_MID,RES2;MID BYTE
	STS B0_SQURE_HIGH,RES3;HIGH BYTE
	CLR RES1
	CLR RES2
	CLR RES3
	CLR RES4
	RCALL CLEAR
	;-----(80XB0^2)/3------
	LDS R17,B0_SQURE_LOW
	LDS R18,B0_SQURE_MID
	LDS R20,B0_SQURE_HIGH
	LDI R26,0X03
	LDI R27,0X00
	LDI R28,0X00
	RCALL DIV
	STS B0_SQURE_LOW,R16;LOW BYTE
	STS B0_SQURE_MID,R23;MID BYTE
	STS B0_SQURE_HIGH,R29;HIGH BYTE
	;-----ADD----------------
	MOV R17,R16
	MOV R18,R23
	MOV R20,R29
	LDS R21,DOWN_ROOT_01_L
	LDS R22,DOWN_ROOT_01_M
	LDS R23,DOWN_ROOT_01_H
	LDI R24,0X00
	ADD R17,R21
	ADC R18,R22
	ADC R20,R23
	STS SQURE_LOW,R17;LOW BYTE
	STS SQURE_MID,R18;MID BYTE
	STS SQURE_HIGH,R20;HIGH BYTE
	LDS R24,SQURE_LOW
	LDS R25,SQURE_MID
	LDS R26,SQURE_HIGH
	RCALL SQURE_ROOT
ROOT1:
	STS SQURE_LOW,R20
	STS SQURE_MID,R21
	RCALL CLEAR
	CLR RES1
	CLR RES2
	CLR RES3
	CLR RES4
	;----------3C------------------------
	LDI R16,0X03;
	LDI R17,0X00
	LDS R30,TEMP_L
	LDS R31,TEMP_H
	RCALL MULTI
	MOV R17,RES1  ;R2 ;LOW BYTE
	MOV R18,RES2  ;R3 ;MID BYTE
	MOV R20,RES3  ;R4 ;HIGH BYTE
	;--------------3C+/-X-----------------------
	LDI R16,LOW(R0_SIGN)
	SBRS R16,0
	RJMP BRANCH_01
	LDS R16,SQURE_LOW
	LDS R19,SQURE_MID
	LDI R21,0X00
	SUB R16,R17
	SBC R19,R18
	SBC R21,R20
	JMP ROOT2
BRANCH_01:	
	RCALL ADD_VALUE
ROOT2:
	;-------(3C+X)*PI---------------------------
	MOV R17,R19
	LDI R30,LOW(PI)
	LDI R31,HIGH(PI)
	RCALL MULTI
	STS SQURE_LOW,R2;LOW BYTE
	STS SQURE_MID,R3;MID BYTE
	STS SQURE_HIGH,R4;HIGH BYTE
	;-------8*18000*A0---------------------------
	LDS R16,B0_LOW
	LDS R17,B0_HIGH
	LDI R30,0X0A
	LDI R31,0X00
	RCALL MULTI
	MOV R16,RES1
	MOV R17,RES2
	LDI R30,LOW(UPPER_MULTI)
	LDI R31,HIGH(UPPER_MULTI)
	RCALL MULTI
;-------FINAL--------------------------
	MOV R17,RES1
	MOV R18,RES2
	MOV R20,RES3
	LDS R26,SQURE_LOW
	LDS R27,SQURE_MID
	LDS R28,SQURE_HIGH
	RCALL DIV
;-------------------------FINAL VALUE IS SAVE IN THE RELAVANT MEMORY ADDRESS--------------------
	STS X_FINAL,R16


;-----------------------------------------------------------------------------------------------
	MOV R30,R16
	LDI  R19,48
	RCALL ASCII
	RCALL DELAY_MS
	RCALL CLEAR
;-----------------------------------------------------------------------------------------------

;IF YOU WANT TO THE GET THE FINAL VALUE AND THE SIGN OF THE FINAL VALUE YOU CAN USE "FINAL" MEMORY ADDRESS TO ACCESS THE FINAL VALUE AND THE SIGN CAN BE GET BY ACCESS "A0_SIGN"
;MEMORY ADDRESS IN THE SIGN MEMORY "1" REPRESENT NEGATIVE AS WELL AS "0" REPRESENT THE POSITIVE 

	
	
	;REMOVE PREVIOUS BULB VALUES
	CBI PORTD, 0
	CBI PORTD, 1
	CBI PORTD, 2
	CBI PORTD, 3

	CBI PORTB, 2
	CBI PORTB, 3
	CBI PORTB, 4
	CBI PORTB, 5

	LDS R20, X_FINAL
	LDS R21, A0_SIGN
	LDI R18, 0B00000001
	
	
	LDI R17, FIVE
	CP R20, R17	
	BRSH SIGNCHECK
	;LDI R16, 0B00000100
	SBI PORTB, 2
	;LDI R17, 0B00000001
	SBI PORTD, 0
	;OUT PORTD, R17
	;OUT PORTB, R16
	RCALL CLEAR
	RJMP MAIN

SIGNCHECK:
	AND R21, R18
	CP R18, R21
	BREQ MINUSSIGNAL
	BRNE PLUSSIGNAL

MINUSSIGNAL:
	LDI R17, FOURTY
	CP  R20, R17
	BRSH MINUSSEVENTY
	;LDI R16, 0B00000100
	;OUT PORTB, R16
	SBI PORTB, 2
	RCALL CLEAR
	RJMP MAIN

	MINUSSEVENTY:
		LDI R17, SEVENTY
		CP R20, R17
		BRSH MINUSNINTY
		;LDI R16, 0B00001100
		;OUT PORTB, R16
		SBI PORTB, 2
		SBI PORTB, 3
		RCALL CLEAR
		RJMP MAIN

		MINUSNINTY:
			;LDI R16, 0B00011100
			;OUT PORTB, R16
			SBI PORTB, 2
			SBI PORTB, 3
			SBI PORTB, 4
			RCALL CLEAR
			RJMP MAIN

PLUSSIGNAL:
	LDI R17, FOURTY
	CP  R20, R17
	BRSH PLUSSEVENTY
	;LDI R17, 0B00000001
	;OUT PORTD, R17
	SBI PORTD, 0
	RCALL CLEAR
	RJMP MAIN

	PLUSSEVENTY:
		LDI R17, SEVENTY
		CP R20, R17
		BRSH PLUSNINTY
		;LDI R17, 0B00000011
		;OUT PORTD, R17
		SBI PORTD, 0
		SBI PORTD, 1
		RCALL CLEAR
		RJMP MAIN

		PLUSNINTY:
			;LDI R17, 0B00000111
			;OUT PORTD, R17
			SBI PORTD, 0
			SBI PORTD, 1
			SBI PORTD, 2
			RCALL CLEAR
			RJMP MAIN


;-----------------------------------------------------------------------------------------------
	RJMP MAIN
	
;-----------------------------------------------------------------------------------------------
;LCD INITIALIZING
LCD_INIT:
	LDI R18,0X33
	RCALL COMMAND_WRITE ;INITIALIZING THE LCD FOR 4-BIT DATA 
	RCALL DELAY_MS
	LDI R18,0X32
	RCALL COMMAND_WRITE ;INITIALIZING THE LCD FOR 4-BIT DATA
	RCALL DELAY_MS
	LDI R18,0X28
	RCALL COMMAND_WRITE ;LCD 2 LINES,5X7 MATRIX
	RCALL DELAY_MS
	LDI R18,0X0C
	RCALL COMMAND_WRITE ;DISPLAY ON,CURSOR OFF
	LDI R18,0X01
	RCALL COMMAND_WRITE ;CLEAR LCD
	RCALL DELAY_MS
	LDI R18,0X06
	RCALL COMMAND_WRITE ;SHIFT CURSOR RIGHT
	RCALL DELAY_MS
	RCALL WORD
	RCALL DELAY_MS
	LDI R18 ,0XC0
	RCALL COMMAND_WRITE
	RCALL DELAY_MS
	RET
;-------------------------------------------------------------------------------------------------
;COMMAND WRITE
COMMAND_WRITE:
	MOV R27,R18
	ANDI R27,0XF0 ;MASK LOW NIBBLE & KEEP HIGH NIBBLE
	OUT PORTD,R27 ;O/P COMMAND HIGH NOBBLE TO PORT D
	CBI PORTB,1   ;RS=0 FOR COMMAND
	SBI PORTB,0   ;EN=1
	CALL DELAY_SHORT
	CBI PORTB,0   ;SEND A IMPLUSE TO THE EN PIN
	RCALL DELAY_US ;DELAY IN MICRO SECOND

	MOV R27,R18
	SWAP R27
	ANDI R27,0XF0
	OUT PORTD,R27
	SBI PORTB,0
	RCALL DELAY_SHORT
	CBI PORTB,0 ;SEND A IMPLUSE TO THE EN PIN
	RCALL DELAY_US
	RET
;-------------------------------------------------------------------------------------------------
;DATA WRITE FUNCTION
DATA_WRITE:
	MOV R27,R18
	ANDI R27,0XF0
	OUT PORTD,R27
	SBI PORTB,1
	SBI PORTB,0
	RCALL DELAY_SHORT
	CBI PORTB,0
	RCALL DELAY_SHORT
	
	MOV R27,R18
	SWAP R27
	ANDI R27,0XF0
	OUT PORTD,R27
	SBI PORTB,0
	RCALL DELAY_SHORT
	CBI PORTB,0 
	RCALL DELAY_US
	RET
;-------------------------------------------------------------------------------------------------------
;PRINT THE ANGLE WORD IN THE LCD
WORD:
	LDI R18,'A'
	RCALL DATA_WRITE
	LDI R18,'N'
	RCALL DATA_WRITE
	LDI R18,'G'
	RCALL DATA_WRITE
	LDI R18,'L'
	RCALL DATA_WRITE
	LDI R18,'E'
	RCALL DATA_WRITE
	LDI R18,' '
	RCALL DATA_WRITE
	LDI R18,':'
	RCALL DATA_WRITE
	LDI R18,' '
	RCALL DATA_WRITE
	RET
;-----------------------------------------------------------------------------------------------------
ASCII:
	CLR R24 ;SET THE COUNTER2 INTIAL VALUE O
	CLR R25 ;SET THE COUNTER3 INTIAL VALUE O
	;CLEAR THE LCD 2ND LINE
	LDI R18,' '
	RCALL DATA_WRITE
	LDI R18,' '
	RCALL DATA_WRITE
	LDI R18,' '
	RCALL DATA_WRITE
	LDI R18,' '
	RCALL DATA_WRITE
	LDI R18,' '
	RCALL DATA_WRITE
	LDI R18,0XC0
	RCALL COMMAND_WRITE
	LDI R18,'X'
	RCALL DATA_WRITE
	LDI R18,':'
	RCALL DATA_WRITE
LOOP9:
	MOV R27,R30
	CPI R30,100
RUN1:
	BRMI LOOP10 ;JUMP WHEN R30<100
RUN2:
	INC R24
	SUBI R30,100 ;R30=R30-100
	RJMP LOOP9

LOOP10:
	CPI R30,10 ;COMPARE R30 WITH 10
	BRMI DSP
	INC R25
	SUBI R30,10
	RJMP LOOP10

DSP:
	LDI  R19,48
CHECK_01:
	CLR R28
	CPSE R27,R28
	RCALL SIGN


BRANCH2:
	MOV R18,R25
	ADD R18,R19
	RCALL DATA_WRITE

BRANCH3:
	MOV R18,R30
	ADD R18,R19
	RCALL DATA_WRITE

	LDI R18,0XC0
	RCALL COMMAND_WRITE
	RCALL DELAY_MS
 
	RET
;--------------------------------------------------------------------------------------------------------------
MAP:
;(1.48*X-493)
	LDI R16,0X94;148
	LDI R17,0X00
	RCALL MULTI
	MOV R17,RES1  ;R2
	MOV R18,RES2  ;R3
	LDI R20,0X00
	CLR R16
	CLR RES1
	CLR RES2
	CLR RES3
	CLR RES4
	LDI R26,LOW(NUM1)
	LDI R27,HIGH(NUM1)
	LDI R28,0X00
	RCALL DIV

	SUBI R16,LOW(SUB_NUM)
	SBCI R23,HIGH(SUB_NUM)
	MOV R17,R23
	BRMI COMPLEMENT
	RET
;--------------------------------------------------------------------------------------------------------------
MULTI:
	CLR R19
	MUL R31,R17;HIGH
	MOV RES3,R0
	MOV RES4,R1

	MUL R30,R16;LOW
	MOV RES1,R0
	MOV RES2,R1

	MUL R31,R16
	ADD RES2,R0
	ADC RES3,R1
	ADC RES4,R19

	MUL R30,R17
	ADD RES2,R0
	ADC RES3,R1
	ADC RES4,R19
	RET
;--------------------------------------------------------------------------------------------------------------
COMPLEMENT:
	COM R16
	COM R17
	LDI R18,0X01
	ADD R16,R18
	LDI R18,0X00
	ADC R17,R18
	LDI R22,0X01
	RET
;--------------------------------------------------------------------------------------------------------------

DIV:
	CLR R16
	CLR R23
	CLR R29
	CLR R19
	CLR R22
	LDI R21,0X01
	CLR R24
NEW_01:
	SUB R17,R26
	SBC R18,R27
	SBC R20,R28
	SBC R19,R22
	BRPL LOAD
	RET	

LOAD:
	ADD R16,R21;
	ADC R23,R24
	ADC R29,R24
	RJMP NEW_01
;----------------------------------------------------------------------------------------------------------------
SIGN:
	CLR R18
	LDI R22,0X00
	LDS R18,A0_SIGN
	CPSE R18,R22
	BRPL MINS
	RCALL PLUS
JUMP_01:
	RET

MINS:
	LDI R18,'-'
	RCALL DATA_WRITE
	RJMP JUMP_01
PLUS:
	LDI R18,'+'
	RCALL DATA_WRITE
	RJMP JUMP_01
;----------------------------------------------------------------------------------------------------------------
POWER:
	MOV R16,R18
	MOV R17,R27
	MOV R31,R27
	MOV R30,R18
	RCALL MULTI
	RET
;----------------------------------------------------------------------------------------------------------------
SQURE_ROOT:
	CLR R20
	CLR R23
	LDI R22,0x04;HIGH BYTE
	MOV R18,R22
	CLR R29	;LOW BYTE
	CLR R28	;HIGH BYTE
	RJMP GONE2
GONE1:
	MOV R28,R20
	LSR R22
	BREQ GONE3
GONE2:
	MOV R18,R22
	OR R28,R18
	MOV R18,R29
	MOV R27,R28
	RCALL POWER
	CP R24,RES1
	CPC R25,RES2
	CPC R26,RES3
	CPC R23,RES4
	BRMI GONE1
	RCALL SAVE1
SAVE1:
	MOV R20,R28
	RJMP GONE1
GONE3:
	MOV R21,R20;HIGH BYTE
	CLR R20
	LDI R22,0X80
	MOV R18,R22
	CLR R29
	MOV R28,R21
	RJMP GONE5
GONE4:
	MOV R29,R20
	LSR R22
	BREQ DONE
GONE5:
	MOV R18,R22
	OR R29,R18
	MOV R18,R29
	MOV R27,R28
	RCALL POWER
	CP R24,RES1
	CPC R25,RES2
	CPC R26,RES3
	CPC R23,RES4
	BRMI GONE4
	RCALL SAVE2
SAVE2:
	MOV R20,R29
	RJMP GONE4
DONE:
	RET
;----------------------------------------------------------------------------------------------------------------
ADD_VALUE:
	LDS R16,SQURE_LOW
	LDS R19,SQURE_MID
	LDI R21,0X00
	ADD R16,R17
	ADC R19,R18
	ADC R21,R20
	RET
;----------------------------------------------------------------------------------------------------------------
SUB_VALUE:
	LDS R16,SQURE_LOW
	LDS R19,SQURE_MID
	LDI R21,0X00
	SUB R16,R17
	SBC R19,R18
	SBC R21,R20
	JMP ROOT2
;----------------------------------------------------------------------------------------------------------------

;-----------------------------------------------------------------------------------------------------
;DELAY SHORT
DELAY_SHORT:
	NOP
	NOP
	RET
;------------------------------------------------------------------------------------------------------
;DELAY MICRO SECONDS
DELAY_US:
	LDI R20,90
LOOP2:
	RCALL DELAY_SHORT
	DEC R20
	BRNE LOOP2
	RET
;------------------------------------------------------------------------------------------------------
;DELAY MILISECONDS
DELAY_MS:
	LDI R21,40
LOOP3:
	RCALL DELAY_US
	DEC R21
	BRNE LOOP3
	RET
;------------------------------------------------------------------------------------------------------
;DELAY_SECONDS
DELAY_SECONDS:
	LDI R20,255
LOOP4:
	LDI R21,255
LOOP5:
	LDI R22,80
LOOP6:
	DEC R22
	BRNE LOOP6
	DEC R21
	BRNE LOOP5
	DEC R20
	BRNE LOOP4
	RET
;------------------------------------------------------------------------------------------------------
CLEAR:
	CLR R16
	CLR R17
	CLR R18
	CLR R19
	CLR R20
	CLR R21
	CLR R22
	CLR R23
	CLR R24
	CLR R25
	CLR R26
	CLR R27
	CLR R28
	CLR R29
	CLR R30
	CLR R31
	RET
;------------------------------------------------------------------------------------------------------
